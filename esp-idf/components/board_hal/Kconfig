## esp-idf/components/board_hal/Kconfig
```kconfig
menu "QNOB Hardware Configuration"

    choice QNOB_HARDWARE_TARGET
        prompt "Target Hardware Platform"
        default QNOB_HW_ESP32S3_LCD_128
        help
            Select the target hardware platform for QNOB.

        config QNOB_HW_ESP32S3_LCD_128
            bool "ESP32-S3 with 1.28\" GC9A01 LCD (240x240)"
            depends on IDF_TARGET_ESP32S3
            help
                Waveshare ESP32-S3-Touch-LCD-1.28 board with GC9A01 round LCD display.

        config QNOB_HW_ESP32S3_AMOLED_175
            bool "ESP32-S3 with 1.75\" AMOLED (CO5300 QSPI, 466x466)"
            depends on IDF_TARGET_ESP32S3
            help
                Waveshare ESP32-S3-Touch-AMOLED-1.75 board using the CO5300-compatible
                QSPI AMOLED path and CST9217 capacitive touch controller.

        config QNOB_HW_ESP32C6_AMOLED_143
            bool "ESP32-C6 with 1.43\" AMOLED (SH8601 QSPI, 466x466)"
            depends on IDF_TARGET_ESP32C6
            help
                Waveshare ESP32-C6-Touch-AMOLED-1.43 board using the SH8601-compatible QSPI AMOLED path.
    endchoice

    choice QNOB_DISPLAY_ROTATION
        prompt "Display Rotation (clockwise)"
        default QNOB_DISPLAY_ROTATION_270 if QNOB_HW_ESP32S3_AMOLED_175
        default QNOB_DISPLAY_ROTATION_0
        help
            Logical display rotation applied by the firmware. Use this to correct
            board-specific panel orientation mismatches. On the current AMOLED
            backends, 90 and 270 degree rotations are handled by LVGL software
            rotation instead of panel-driver axis swapping.

        config QNOB_DISPLAY_ROTATION_0
            bool "0 degrees"

        config QNOB_DISPLAY_ROTATION_90
            bool "90 degrees"

        config QNOB_DISPLAY_ROTATION_180
            bool "180 degrees"

        config QNOB_DISPLAY_ROTATION_270
            bool "270 degrees"
    endchoice

    choice QNOB_TOUCH_ROTATION
        prompt "Touch Rotation (clockwise)"
        default QNOB_TOUCH_ROTATION_0
        help
            Rotation applied to raw touch coordinates before gesture detection
            and screen interaction logic. Use this when the touch sensor wiring
            does not match the final logical display orientation.

        config QNOB_TOUCH_ROTATION_0
            bool "0 degrees"

        config QNOB_TOUCH_ROTATION_90
            bool "90 degrees"

        config QNOB_TOUCH_ROTATION_180
            bool "180 degrees"

        config QNOB_TOUCH_ROTATION_270
            bool "270 degrees"
    endchoice

    config QNOB_TOUCH_MIRROR_X
        bool "Mirror Touch X Axis"
        default n
        help
            Mirror the transformed touch X coordinate across the visible screen.
            Leave disabled unless the touch controller still reports left/right
            reversed after applying touch rotation.

    config QNOB_TOUCH_MIRROR_Y
        bool "Mirror Touch Y Axis"
        default n
        help
            Mirror the transformed touch Y coordinate across the visible screen.
            Leave disabled unless the touch controller still reports up/down
            reversed after applying touch rotation.

    config QNOB_ENABLE_TOUCH
        bool "Enable Touch Panel"
        default y
        help
            Enable the target-specific capacitive touch panel
            (CST816S on the 1.28 S3 board, CST9217 on the 1.75 S3 AMOLED board,
            FT6x36-compatible on the C6 AMOLED board).

    config QNOB_ENABLE_IMU
        bool "Enable IMU Sensor"
        default n
        help
            Enable the QMI8658 IMU sensor for motion detection.

    config QNOB_ENABLE_KNOB_UART
        bool "Enable Knob UART Communication"
        default n if QNOB_HW_ESP32C6_AMOLED_143
        default y
        help
            Enable UART communication with the external knob controller.
            Off by default on the ESP32-C6 AMOLED 1.43 because its mapped
            pins (GPIO 1/2) collide with the TCA9554 interrupt line and
            PWR_KEY; enable it only after remapping those pins.

    config QNOB_KNOB_BAUD_RATE
        int "Knob UART Baud Rate"
        default 9600
        depends on QNOB_ENABLE_KNOB_UART
        help
            Baud rate for UART communication with knob controller.

    config QNOB_ENABLE_DEEP_SLEEP
        bool "Enable Deep Sleep"
        default y
        help
            Enable deep sleep mode for power saving.

    config QNOB_INACTIVITY_TIMEOUT_SEC
        int "Inactivity Timeout (seconds)"
        default 30
        depends on QNOB_ENABLE_DEEP_SLEEP
        help
            Time in seconds before entering sleep mode due to inactivity.

    config QNOB_WIFI_CONNECT_TIMEOUT_SEC
        int "WiFi Connection Timeout (seconds)"
        default 10
        help
            Maximum time to wait for WiFi connection.

endmenu
```

## esp-idf/main/Kconfig.projbuild
```kconfig
menu "QNOB Application Configuration"

    config QNOB_DEVICE_NAME
        string "Default Device Name"
        default "QNOB"
        help
            Default name for the device, used for MQTT client ID and display.

    config QNOB_WIFI_SSID
        string "Default WiFi SSID"
        default ""
        help
            Default WiFi SSID for initial connection.

    config QNOB_WIFI_PASSWORD
        string "Default WiFi Password"
        default ""
        help
            Default WiFi password for initial connection.

    config QNOB_MQTT_BROKER_URL
        string "Default MQTT Broker URL"
        default ""
        help
            Default MQTT broker URL (e.g., mqtt://broker.example.com)

    config QNOB_MQTT_BROKER_PORT
        int "Default MQTT Broker Port"
        default 1883
        help
            Default MQTT broker port.

    config QNOB_LOG_LEVEL
        int "Log Level (0=None, 1=Error, 2=Warn, 3=Info, 4=Debug, 5=Verbose)"
        default 3
        range 0 5
        help
            Set the logging verbosity level.

    config QNOB_MODEL_TRACE
        bool "Model trace: log every drain and each changed model (MDL-32)"
        default n
        help
            Debug aid for the MVC refactor. One log line per display-task drain plus one per
            committed model, and a counter of model writes observed from any other task.

    config QNOB_UTC_OFFSET_MINUTES
        int "Clock offset from UTC in minutes (no DST)"
        default 180
        range -840 840
        help
            The INFO clock shows UTC plus this offset. Daylight saving is not applied; see
            dev_notes/phase1-log.md (NET-07) for the decision.

    config QNOB_NTP_SERVER_1
        string "Primary NTP server"
        default "pool.ntp.org"

    config QNOB_NTP_SERVER_2
        string "Secondary NTP server"
        default "time.nist.gov"

    config QNOB_WEATHER_API_KEY
        string "OpenWeatherMap API key"
        default ""
        help
            Empty means the weather fetch is disabled and logged as unconfigured. Keep the real
            key in sdkconfig.defaults.local, never in a tracked file.

    config QNOB_WEATHER_CITY
        string "Weather city"
        default "Istanbul"

    config QNOB_WEATHER_COUNTRY
        string "Weather country code"
        default "tr"

endmenu
```

## esp-idf/sdkconfig.defaults
```kconfig
# QNOB Screen Default Configuration
# Common settings for all targets

# Enable C++ exceptions
CONFIG_COMPILER_CXX_EXCEPTIONS=y

# FreeRTOS settings
CONFIG_FREERTOS_HZ=1000
CONFIG_ESP_MAIN_TASK_STACK_SIZE=16384

# Log level
CONFIG_LOG_DEFAULT_LEVEL_INFO=y

# SPI RAM (PSRAM) - if available
CONFIG_SPIRAM_MODE_QUAD=y
CONFIG_SPIRAM_SPEED_80M=y

# Partition table
CONFIG_PARTITION_TABLE_CUSTOM=y
CONFIG_PARTITION_TABLE_CUSTOM_FILENAME="partitions.csv"

# WiFi settings
CONFIG_ESP_WIFI_STATIC_RX_BUFFER_NUM=10
CONFIG_ESP_WIFI_DYNAMIC_RX_BUFFER_NUM=32
CONFIG_ESP_WIFI_DYNAMIC_TX_BUFFER_NUM=32

# LWIP settings
CONFIG_LWIP_MAX_SOCKETS=16
CONFIG_LWIP_SO_REUSE=y
CONFIG_LWIP_SO_RCVBUF=y
CONFIG_LWIP_IPV6=y
CONFIG_LWIP_IPV6_AUTOCONFIG=y

# NVS
CONFIG_NVS_ENCRYPTION=n

# FATFS (required for long media folder/file names on SD card)
# CONFIG_FATFS_LFN_NONE is not set
CONFIG_FATFS_LFN_HEAP=y
# Use 512-byte sectors to match SD card physical sector size
CONFIG_FATFS_SECTOR_512=y
# CONFIG_FATFS_SECTOR_4096 is not set

# LVGL
CONFIG_LV_BUILD_EXAMPLES=n
CONFIG_LV_MEM_SIZE_KILOBYTES=64
CONFIG_LV_MEM_BUF_MAX_NUM=32
CONFIG_LV_USE_QRCODE=y
CONFIG_LV_FONT_MONTSERRAT_32=y
```

## esp-idf/sdkconfig.defaults.esp32s3
```kconfig
# ESP32-S3 Specific Configuration
# Target: Waveshare ESP32-S3-Touch-LCD-1.28 with GC9A01

CONFIG_IDF_TARGET="esp32s3"

# CPU frequency
CONFIG_ESP_DEFAULT_CPU_FREQ_MHZ_240=y

# Flash settings
CONFIG_ESPTOOLPY_FLASHSIZE_16MB=y
CONFIG_ESPTOOLPY_FLASHMODE_QIO=y
CONFIG_ESPTOOLPY_FLASHFREQ_80M=y

# PSRAM
CONFIG_ESP32S3_SPIRAM_SUPPORT=y
CONFIG_SPIRAM=y
CONFIG_SPIRAM_MODE_OCT=y
CONFIG_SPIRAM_SPEED_80M=y

# USB Console (ESP32-S3 has USB)
CONFIG_ESP_CONSOLE_USB_SERIAL_JTAG=y

# OTA (allow HTTP updates for local testing)
CONFIG_ESP_HTTPS_OTA_ALLOW_HTTP=y
CONFIG_OTA_ALLOW_HTTP=y
```

## src/esp-idf/components/board_hal/Kconfig
```kconfig
menu "QNOB Hardware Configuration"

    choice QNOB_HARDWARE_TARGET
        prompt "Target Hardware Platform"
        default QNOB_HW_ESP32S3_LCD_128
        help
            Select the target hardware platform for QNOB.

        config QNOB_HW_ESP32S3_LCD_128
            bool "ESP32-S3 with 1.28\" GC9A01 LCD (240x240)"
            depends on IDF_TARGET_ESP32S3
            help
                Waveshare ESP32-S3-Touch-LCD-1.28 board with GC9A01 round LCD display.

        config QNOB_HW_ESP32S3_AMOLED_175
            bool "ESP32-S3 with 1.75\" AMOLED (CO5300 QSPI, 466x466)"
            depends on IDF_TARGET_ESP32S3
            help
                Waveshare ESP32-S3-Touch-AMOLED-1.75 board using the CO5300-compatible
                QSPI AMOLED path and CST9217 capacitive touch controller.

        config QNOB_HW_ESP32C6_AMOLED_143
            bool "ESP32-C6 with 1.43\" AMOLED (SH8601 QSPI, 466x466)"
            depends on IDF_TARGET_ESP32C6
            help
                Waveshare ESP32-C6-Touch-AMOLED-1.43 board using the SH8601-compatible QSPI AMOLED path.
    endchoice

    config QNOB_ENABLE_TOUCH
        bool "Enable Touch Panel"
        default y
        help
            Enable the target-specific capacitive touch panel
            (CST816S on the 1.28 S3 board, CST9217 on the 1.75 S3 AMOLED board,
            FT6x36-compatible on the C6 AMOLED board).

    config QNOB_ENABLE_IMU
        bool "Enable IMU Sensor"
        default n
        help
            Enable the QMI8658 IMU sensor for motion detection.

    config QNOB_ENABLE_KNOB_UART
        bool "Enable Knob UART Communication"
        default y
        help
            Enable UART communication with external knob controller.

    config QNOB_KNOB_BAUD_RATE
        int "Knob UART Baud Rate"
        default 9600
        depends on QNOB_ENABLE_KNOB_UART
        help
            Baud rate for UART communication with knob controller.

    config QNOB_ENABLE_DEEP_SLEEP
        bool "Enable Deep Sleep"
        default y
        help
            Enable deep sleep mode for power saving.

    config QNOB_INACTIVITY_TIMEOUT_SEC
        int "Inactivity Timeout (seconds)"
        default 30
        depends on QNOB_ENABLE_DEEP_SLEEP
        help
            Time in seconds before entering sleep mode due to inactivity.

    config QNOB_WIFI_CONNECT_TIMEOUT_SEC
        int "WiFi Connection Timeout (seconds)"
        default 10
        help
            Maximum time to wait for WiFi connection.

endmenu
```

## src/esp-idf/main/Kconfig.projbuild
```kconfig
menu "QNOB Application Configuration"

    config QNOB_DEVICE_NAME
        string "Default Device Name"
        default "QNOB"
        help
            Default name for the device, used for MQTT client ID and display.

    config QNOB_WIFI_SSID
        string "Default WiFi SSID"
        default ""
        help
            Default WiFi SSID for initial connection.

    config QNOB_WIFI_PASSWORD
        string "Default WiFi Password"
        default ""
        help
            Default WiFi password for initial connection.

    config QNOB_MQTT_BROKER_URL
        string "Default MQTT Broker URL"
        default ""
        help
            Default MQTT broker URL (e.g., mqtt://broker.example.com)

    config QNOB_MQTT_BROKER_PORT
        int "Default MQTT Broker Port"
        default 1883
        help
            Default MQTT broker port.

    config QNOB_LOG_LEVEL
        int "Log Level (0=None, 1=Error, 2=Warn, 3=Info, 4=Debug, 5=Verbose)"
        default 3
        range 0 5
        help
            Set the logging verbosity level.

endmenu
```

## src/esp-idf/sdkconfig.defaults.esp32s3_lcd128
```kconfig
# Waveshare ESP32-S3-Touch-LCD-1.28 board overlay

CONFIG_QNOB_HW_ESP32S3_LCD_128=y
```
